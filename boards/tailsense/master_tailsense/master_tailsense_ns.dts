/dts-v1/;
#include <nordic/nrf9161ns_laca.dtsi>
#include "master_tailsense-pinctrl.dtsi"
#include "master_tailsense-partitioning.dtsi"

/ {
	chosen {
		zephyr,flash = &flash0;
		zephyr,sram = &sram0_ns;
		zephyr,code-partition = &slot0_ns_partition;
	};
};
